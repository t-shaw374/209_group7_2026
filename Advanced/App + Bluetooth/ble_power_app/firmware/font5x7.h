/*
 * font5x7.h  -  5 x 7 pixel font, columns left to right, bit 0 = top row
 *
 * Covers space, - . / : 0-9 and A-Z (lower case is drawn as upper case).
 */

#ifndef FONT5X7_H_
#define FONT5X7_H_

#include <stdint.h>
#include "pgm_compat.h"

static const uint8_t font_punct[][5] PROGMEM = {
	{0x00, 0x00, 0x00, 0x00, 0x00}, /* space */
	{0x08, 0x08, 0x08, 0x08, 0x08}, /* -  */
	{0x00, 0x60, 0x60, 0x00, 0x00}, /* .  */
	{0x20, 0x10, 0x08, 0x04, 0x02}, /* /  */
	{0x00, 0x36, 0x36, 0x00, 0x00}, /* :  */
};

static const uint8_t font_digit[10][5] PROGMEM = {
	{0x3E, 0x51, 0x49, 0x45, 0x3E}, /* 0 */
	{0x00, 0x42, 0x7F, 0x40, 0x00}, /* 1 */
	{0x42, 0x61, 0x51, 0x49, 0x46}, /* 2 */
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	{0x06, 0x49, 0x49, 0x29, 0x1E}, /* 9 */
};

static const uint8_t font_alpha[26][5] PROGMEM = {
	{0x7E, 0x11, 0x11, 0x11, 0x7E}, /* A */
	{0x7F, 0x49, 0x49, 0x49, 0x36}, /* B */
	{0x3E, 0x41, 0x41, 0x41, 0x22}, /* C */
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	{0x61, 0x51, 0x49, 0x45, 0x43}, /* Z */
};

/* One column (0-4) of a character; 0 for the gap column (5) or unknown chars. */
static inline uint8_t font_col(char c, uint8_t col)
{
	if (col > 4) return 0;
	if (c >= 'a' && c <= 'z') c = (char)(c - 'a' + 'A');
	if (c >= '0' && c <= '9') return pgm_read_byte(&font_digit[c - '0'][col]);
	if (c >= 'A' && c <= 'Z') return pgm_read_byte(&font_alpha[c - 'A'][col]);
	switch (c) {
		case '-': return pgm_read_byte(&font_punct[1][col]);
		case '.': return pgm_read_byte(&font_punct[2][col]);
		case '/': return pgm_read_byte(&font_punct[3][col]);
		case ':': return pgm_read_byte(&font_punct[4][col]);
		default:  return 0;
	}
}

/* Column x (in pixels) of a text string drawn from x = 0, 6 pixels per character. */
static inline uint8_t font_text_col(const char *s, uint8_t len, uint8_t x)
{
	uint8_t i = x / 6;
	if (i >= len) return 0;
	return font_col(s[i], x % 6);
}

#endif /* FONT5X7_H_ */
